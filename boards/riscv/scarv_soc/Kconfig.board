## boards/riscv/scarv_soc/Kconfig.board
```kconfig
# Copyright (c) 2019 SiFive Inc.
# SPDX-License-Identifier: Apache-2.0
config BOARD_SCARV_SOC
	bool "SCARV SOC target"
    depends on SOC_RISCV_SCARV_SOC
```

## boards/riscv/scarv_soc/Kconfig.defconfig
```kconfig
# Copyright (c) 2019 SiFive Inc.
# SPDX-License-Identifier: Apache-2.0
if BOARD_SCARV_SOC

config BOARD
	default "scarv_soc"

config HAS_FLASH_LOAD_OFFSET
	default y

config FLASH_BASE_ADDRESS
	default $(dt_node_reg_addr_hex,/soc/spi@10014000,1)

config FLASH_LOAD_OFFSET
	default 0x0

endif
```

## boards/riscv/scarv_soc/scarv_soc_defconfig
```kconfig
CONFIG_RISCV=y
CONFIG_SOC_SERIES_RISCV_SCARV_SOC=y
CONFIG_SOC_RISCV_SCARV_SOC=y
CONFIG_BOARD_SCARV_SOC=y

CONFIG_SERIAL=y
CONFIG_UART_SCARVSOC=y
CONFIG_UART_SCARVSOC_PORT_0=y
CONFIG_TINYCRYPT=y
CONFIG_TINYCRYPT_AES=y
CONFIG_TINYCRYPT_AES_CBC=y

#CONFIG_GEN_IRQ_VECTOR_TABLE=n
#CONFIG_GEN_ISR_TABLES=n

CONFIG_SOC_SERIES_RISCV_SIFIVE_FREEDOM=n
CONFIG_SOC_RISCV_SIFIVE_FREEDOM=n
CONFIG_RISCV_MACHINE_TIMER=y
CONFIG_PLIC=n
CONFIG_GPIO=n
CONFIG_GPIO_SIFIVE=n
CONFIG_PINMUX=n
CONFIG_CONSOLE=y
CONFIG_PRINTK=y
CONFIG_UART_CONSOLE=y
CONFIG_BOOT_BANNER=n
```

## drivers/ethernet/Kconfig.scarvsoc_eth
```kconfig
menuconfig ETH_SCARVSOC
	bool "SCARV SoC Ethernet core driver"

if ETH_SCARVSOC

config ETH_SCARVSOC_RANDOM_MAC
	bool "Random MAC address"
	depends on ENTROPY_GENERATOR
	help
	  Generate a random MAC address dynamically.

endif # ETH_SCARVSOC
```

## drivers/serial/Kconfig.scarvsoc
```kconfig
# SCAR-V SoC UART configuration option

menuconfig UART_SCARVSOC
	bool "SCAR-V SoC serial driver"
	depends on SOC_RISCV_SCARV_SOC
	select SERIAL_HAS_DRIVER
	help
	  This option enables the SCAR-V SoC serial driver.

# ---------- Port 0 ----------

menuconfig UART_SCARVSOC_PORT_0
	bool "Enable SCARVSOC Port 0"
	depends on UART_SCARVSOC
	help
	  This tells the driver to configure the UART port at boot, depending on
	  the additional configure options below.

# ---------- Port 1 ----------

menuconfig UART_SCARVSOC_PORT_1
	bool "Enable SCARVSOC Port 1"
	depends on UART_SCAR-VSoC
	help
	  This tells the driver to configure the UART port at boot, depending on
	  the additional configure options below.
```

## drivers/serial/Kconfig.scarvsoc_uart
```kconfig
# SCAR-V SoC UART configuration option

menuconfig UART_SCARVSOC
	bool "SCAR-V SoC serial driver"
	depends on SOC_RISCV_SCARV_SOC
	select SERIAL_HAS_DRIVER
	help
	  This option enables the SCAR-V SoC serial driver.

menuconfig UART_SCARVSOC_POLL_IN_BLOCKING
    bool "Blocking mode on poll_in"
    depends on UART_SCARVSOC
    default y
    help
        Enable blocking in the poll_in procedure. It's the only method that
        seems to work. Disable this option and poll_in will return -1 if the
        input buffer is empty, rather than polling, doesn't work well with
        console_getchar.

# ---------- Port 0 ----------

menuconfig UART_SCARVSOC_PORT_0
	bool "Enable SCARVSOC Port 0"
	depends on UART_SCARVSOC
	help
	  This tells the driver to configure the UART port at boot, depending on
	  the additional configure options below.

# ---------- Port 1 ----------

menuconfig UART_SCARVSOC_PORT_1
	bool "Enable SCARVSOC Port 1"
	depends on UART_SCAR-VSoC
	help
	  This tells the driver to configure the UART port at boot, depending on
	  the additional configure options below.
```

## dts/bindings/ethernet/scarvsoc,eth0.yaml
```yaml
description: SCARV SoC Ethernet

compatible: "scarvsoc,eth0"

include: ethernet.yaml

properties:
    reg:
        required: true
```

## dts/bindings/serial/scarvsoc,uart0.yaml
```yaml
title: SCAR-V SoC UART

description: |
    This binding gives a base representation of the SCAR-V SoC UART

compatible: "scarvsoc,uart0"

include: uart-controller.yaml

properties:
    reg:
      required: true

    interrupts:
      required: false
```

## dts/bindings/sram/scarvsoc,sram.yaml
```yaml
description: SCARV SoC SRAM

compatible: "scarvsoc,sram"

include: base.yaml

properties:
    reg:
      required: true
```

## soc/riscv/riscv-privilege/scarv_soc/Kconfig.defconfig.series
```kconfig
# SPDX-License-Identifier: Apache-2.0

if SOC_SERIES_RISCV_SCARV_SOC

config SOC_SERIES
	default "scarv_soc"

config SYS_CLOCK_HW_CYCLES_PER_SEC
	default 32768

config RISCV_SOC_INTERRUPT_INIT
	default n

config RISCV_HAS_CPU_IDLE
	default n

config RISCV_HAS_PLIC
	default n

config NUM_IRQS
	default 64

config XIP
	default n

config XCRYPTO
    bool "XCrypto Support"
    default y
    help
      This option enables XCrypto support.

endif # SOC_SERIES_RISCV_SCARV_SOC
```

## soc/riscv/riscv-privilege/scarv_soc/Kconfig.series
```kconfig
# RISCV_SIFIVE_FREEDOM SOC implementation

# Copyright (c) 2017 Jean-Paul Etienne <fractalclone@gmail.com>
# SPDX-License-Identifier: Apache-2.0

config SOC_SERIES_RISCV_SCARV_SOC
	bool "SCARV SOC implementation"
	select RISCV
	select SOC_FAMILY_RISCV_PRIVILEGE
	help
	  Enable support for SCARV SOC
```

## soc/riscv/riscv-privilege/scarv_soc/Kconfig.soc
```kconfig
# RISCV_SIFIVE_FREEDOM SOC configuration options

# Copyright (c) 2017 Jean-Paul Etienne <fractalclone@gmail.com>
# SPDX-License-Identifier: Apache-2.0

choice
	prompt "SCARV SOC implementation"
	depends on SOC_SERIES_RISCV_SCARV_SOC

config SOC_RISCV_SCARV_SOC
	bool "SCARV SOC implementation"
	select ATOMIC_OPERATIONS_C

endchoice
```
